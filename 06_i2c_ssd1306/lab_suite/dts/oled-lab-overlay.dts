/dts-v1/;
/plugin/;

/ {
    compatible = "brcm,bcm2711";
    fragment@0 {
        target = <&i2c1>;
        __overlay__ {
            status = "okay";
            #address-cells = <1>;
            #size-cells = <0>;
            oled@3c {
                compatible = "learning,ssd1306-128x32";
                reg = <0x3c>;
                status = "okay";
            };
        };
    };
};
